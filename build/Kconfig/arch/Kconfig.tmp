## build/Kconfig/soc/Kconfig.sysbuild
```kconfig
# Load Sysbuild SoC Kconfig descriptions.
osource "D:/zephyrdev/zephyr/soc/xlnx/zynqmp/Kconfig.sysbuild"
osource "D:/zephyrdev/zephyr/soc/xlnx/zynq7000/Kconfig.sysbuild"
osource "D:/zephyrdev/zephyr/soc/xlnx/versalnet/Kconfig.sysbuild"
osource "D:/zephyrdev/zephyr/soc/xlnx/versal2/Kconfig.sysbuild"
osource "D:/zephyrdev/zephyr/soc/xlnx/versal/Kconfig.sysbuild"
osource "D:/zephyrdev/zephyr/soc/xen/Kconfig.sysbuild"
osource "D:/zephyrdev/zephyr/soc/wch/ch32v/Kconfig.sysbuild"
osource "D:/zephyrdev/zephyr/soc/ti/simplelink/Kconfig.sysbuild"
osource "D:/zephyrdev/zephyr/soc/ti/mspm0/Kconfig.sysbuild"
osource "D:/zephyrdev/zephyr/soc/ti/lm3s6965/Kconfig.sysbuild"
osource "D:/zephyrdev/zephyr/soc/ti/k3/Kconfig.sysbuild"
osource "D:/zephyrdev/zephyr/soc/telink/tlsr/Kconfig.sysbuild"
osource "D:/zephyrdev/zephyr/soc/syna/sr100/Kconfig.sysbuild"
osource "D:/zephyrdev/zephyr/soc/starfive/jh71xx/Kconfig.sysbuild"
osource "D:/zephyrdev/zephyr/soc/st/stm32/Kconfig.sysbuild"
osource "D:/zephyrdev/zephyr/soc/snps/qemu_arc/Kconfig.sysbuild"
osource "D:/zephyrdev/zephyr/soc/snps/nsim/arc_v/Kconfig.sysbuild"
osource "D:/zephyrdev/zephyr/soc/snps/nsim/arc_classic/Kconfig.sysbuild"
osource "D:/zephyrdev/zephyr/soc/snps/hsdk4xd/Kconfig.sysbuild"
osource "D:/zephyrdev/zephyr/soc/snps/hsdk/Kconfig.sysbuild"
osource "D:/zephyrdev/zephyr/soc/snps/emsk/Kconfig.sysbuild"
osource "D:/zephyrdev/zephyr/soc/snps/emsdp/Kconfig.sysbuild"
osource "D:/zephyrdev/zephyr/soc/snps/arc_iot/Kconfig.sysbuild"
osource "D:/zephyrdev/zephyr/soc/silabs/Kconfig.sysbuild"
osource "D:/zephyrdev/zephyr/soc/sifli/sf32/Kconfig.sysbuild"
osource "D:/zephyrdev/zephyr/soc/sifive/sifive_freedom/Kconfig.sysbuild"
osource "D:/zephyrdev/zephyr/soc/sensry/Kconfig.sysbuild"
osource "D:/zephyrdev/zephyr/soc/rockchip/Kconfig.sysbuild"
osource "D:/zephyrdev/zephyr/soc/renode/riscv_virtual/Kconfig.sysbuild"
osource "D:/zephyrdev/zephyr/soc/renode/cortex_r8_virtual/Kconfig.sysbuild"
osource "D:/zephyrdev/zephyr/soc/renesas/smartbond/Kconfig.sysbuild"
osource "D:/zephyrdev/zephyr/soc/renesas/rz/Kconfig.sysbuild"
osource "D:/zephyrdev/zephyr/soc/renesas/rx/Kconfig.sysbuild"
osource "D:/zephyrdev/zephyr/soc/renesas/rcar/Kconfig.sysbuild"
osource "D:/zephyrdev/zephyr/soc/renesas/ra/Kconfig.sysbuild"
osource "D:/zephyrdev/zephyr/soc/realtek/fingerprint/Kconfig.sysbuild"
osource "D:/zephyrdev/zephyr/soc/realtek/ec/Kconfig.sysbuild"
osource "D:/zephyrdev/zephyr/soc/realtek/bee/Kconfig.sysbuild"
osource "D:/zephyrdev/zephyr/soc/realtek/ameba/Kconfig.sysbuild"
osource "D:/zephyrdev/zephyr/soc/raspberrypi/rpi_pico/Kconfig.sysbuild"
osource "D:/zephyrdev/zephyr/soc/quicklogic/eos_s3/Kconfig.sysbuild"
osource "D:/zephyrdev/zephyr/soc/qemu/virt_riscv/Kconfig.sysbuild"
osource "D:/zephyrdev/zephyr/soc/qemu/or1k/Kconfig.sysbuild"
osource "D:/zephyrdev/zephyr/soc/qemu/malta/Kconfig.sysbuild"
osource "D:/zephyrdev/zephyr/soc/openisa/rv32m1/Kconfig.sysbuild"
osource "D:/zephyrdev/zephyr/soc/openhwgroup/cva6/Kconfig.sysbuild"
osource "D:/zephyrdev/zephyr/soc/oct/osd32mp15x/Kconfig.sysbuild"
osource "D:/zephyrdev/zephyr/soc/nxp/s32/Kconfig.sysbuild"
osource "D:/zephyrdev/zephyr/soc/nxp/rw/Kconfig.sysbuild"
osource "D:/zephyrdev/zephyr/soc/nxp/mcx/Kconfig.sysbuild"
osource "D:/zephyrdev/zephyr/soc/nxp/lpc/Kconfig.sysbuild"
osource "D:/zephyrdev/zephyr/soc/nxp/layerscape/Kconfig.sysbuild"
osource "D:/zephyrdev/zephyr/soc/nxp/kinetis/Kconfig.sysbuild"
osource "D:/zephyrdev/zephyr/soc/nxp/imxrt/Kconfig.sysbuild"
osource "D:/zephyrdev/zephyr/soc/nxp/imx/Kconfig.sysbuild"
osource "D:/zephyrdev/zephyr/soc/nuvoton/numicro/Kconfig.sysbuild"
osource "D:/zephyrdev/zephyr/soc/nuvoton/numaker/Kconfig.sysbuild"
osource "D:/zephyrdev/zephyr/soc/nuvoton/npcx/Kconfig.sysbuild"
osource "D:/zephyrdev/zephyr/soc/nuvoton/npcm/Kconfig.sysbuild"
osource "D:/zephyrdev/zephyr/soc/nordic/Kconfig.sysbuild"
osource "D:/zephyrdev/zephyr/soc/neorv32/Kconfig.sysbuild"
osource "D:/zephyrdev/zephyr/soc/native/inf_clock/Kconfig.sysbuild"
osource "D:/zephyrdev/zephyr/soc/microchip/sam/sama7/Kconfig.sysbuild"
osource "D:/zephyrdev/zephyr/soc/microchip/sam/sam_d5x_e5x/Kconfig.sysbuild"
osource "D:/zephyrdev/zephyr/soc/microchip/pic64/Kconfig.sysbuild"
osource "D:/zephyrdev/zephyr/soc/microchip/pic32c/pic32cz_ca/Kconfig.sysbuild"
osource "D:/zephyrdev/zephyr/soc/microchip/pic32c/pic32cx_sg/Kconfig.sysbuild"
osource "D:/zephyrdev/zephyr/soc/microchip/pic32c/pic32cm_pl/Kconfig.sysbuild"
osource "D:/zephyrdev/zephyr/soc/microchip/pic32c/pic32cm_jh/Kconfig.sysbuild"
osource "D:/zephyrdev/zephyr/soc/microchip/miv/Kconfig.sysbuild"
osource "D:/zephyrdev/zephyr/soc/microchip/mec/Kconfig.sysbuild"
osource "D:/zephyrdev/zephyr/soc/mediatek/mt8xxx/Kconfig.sysbuild"
osource "D:/zephyrdev/zephyr/soc/lowrisc/opentitan/Kconfig.sysbuild"
osource "D:/zephyrdev/zephyr/soc/litex/Kconfig.sysbuild"
osource "D:/zephyrdev/zephyr/soc/ite/ec/Kconfig.sysbuild"
osource "D:/zephyrdev/zephyr/soc/intel/wildcat_lake/Kconfig.sysbuild"
osource "D:/zephyrdev/zephyr/soc/intel/raptor_lake/Kconfig.sysbuild"
osource "D:/zephyrdev/zephyr/soc/intel/panther_lake/Kconfig.sysbuild"
osource "D:/zephyrdev/zephyr/soc/intel/lakemont/Kconfig.sysbuild"
osource "D:/zephyrdev/zephyr/soc/intel/intel_socfpga_std/Kconfig.sysbuild"
osource "D:/zephyrdev/zephyr/soc/intel/intel_socfpga/Kconfig.sysbuild"
osource "D:/zephyrdev/zephyr/soc/intel/intel_niosv/Kconfig.sysbuild"
osource "D:/zephyrdev/zephyr/soc/intel/intel_ish/Kconfig.sysbuild"
osource "D:/zephyrdev/zephyr/soc/intel/intel_adsp/Kconfig.sysbuild"
osource "D:/zephyrdev/zephyr/soc/intel/elkhart_lake/Kconfig.sysbuild"
osource "D:/zephyrdev/zephyr/soc/intel/atom/Kconfig.sysbuild"
osource "D:/zephyrdev/zephyr/soc/intel/apollo_lake/Kconfig.sysbuild"
osource "D:/zephyrdev/zephyr/soc/intel/alder_lake/Kconfig.sysbuild"
osource "D:/zephyrdev/zephyr/soc/infineon/psoc4/Kconfig.sysbuild"
osource "D:/zephyrdev/zephyr/soc/infineon/edge/Kconfig.sysbuild"
osource "D:/zephyrdev/zephyr/soc/infineon/cat3/Kconfig.sysbuild"
osource "D:/zephyrdev/zephyr/soc/infineon/cat1c/Kconfig.sysbuild"
osource "D:/zephyrdev/zephyr/soc/infineon/cat1b/Kconfig.sysbuild"
osource "D:/zephyrdev/zephyr/soc/infineon/cat1a/Kconfig.sysbuild"
osource "D:/zephyrdev/zephyr/soc/gd/gd32/Kconfig.sysbuild"
osource "D:/zephyrdev/zephyr/soc/gaisler/leon3/Kconfig.sysbuild"
osource "D:/zephyrdev/zephyr/soc/gaisler/gr716a/Kconfig.sysbuild"
osource "D:/zephyrdev/zephyr/soc/focaltech/Kconfig.sysbuild"
osource "D:/zephyrdev/zephyr/soc/espressif/Kconfig.sysbuild"
osource "D:/zephyrdev/zephyr/soc/ene/kb1200/Kconfig.sysbuild"
osource "D:/zephyrdev/zephyr/soc/ene/kb106x/Kconfig.sysbuild"
osource "D:/zephyrdev/zephyr/soc/elan/em32f967/Kconfig.sysbuild"
osource "D:/zephyrdev/zephyr/soc/egis/Kconfig.sysbuild"
osource "D:/zephyrdev/zephyr/soc/efinix/sapphire/Kconfig.sysbuild"
osource "D:/zephyrdev/zephyr/soc/cdns/xtensa_sample_controller/Kconfig.sysbuild"
osource "D:/zephyrdev/zephyr/soc/cdns/swerv/Kconfig.sysbuild"
osource "D:/zephyrdev/zephyr/soc/cdns/sample_controller32/Kconfig.sysbuild"
osource "D:/zephyrdev/zephyr/soc/cdns/dc233c/Kconfig.sysbuild"
osource "D:/zephyrdev/zephyr/soc/brcm/bcmvk/Kconfig.sysbuild"
osource "D:/zephyrdev/zephyr/soc/brcm/bcm2712/Kconfig.sysbuild"
osource "D:/zephyrdev/zephyr/soc/brcm/bcm2711/Kconfig.sysbuild"
osource "D:/zephyrdev/zephyr/soc/blackberry/qnxhv_vm/Kconfig.sysbuild"
osource "D:/zephyrdev/zephyr/soc/bflb/Kconfig.sysbuild"
osource "D:/zephyrdev/zephyr/soc/atmel/sam0/Kconfig.sysbuild"
osource "D:/zephyrdev/zephyr/soc/atmel/sam/Kconfig.sysbuild"
osource "D:/zephyrdev/zephyr/soc/aspeed/Kconfig.sysbuild"
osource "D:/zephyrdev/zephyr/soc/arm/Kconfig.sysbuild"
osource "D:/zephyrdev/zephyr/soc/arm/beetle/Kconfig.sysbuild"
osource "D:/zephyrdev/zephyr/soc/antmicro/myra/Kconfig.sysbuild"
osource "D:/zephyrdev/zephyr/soc/andestech/Kconfig.sysbuild"
osource "D:/zephyrdev/zephyr/soc/amd/acp_7_0/Kconfig.sysbuild"
osource "D:/zephyrdev/zephyr/soc/amd/acp_6_0/Kconfig.sysbuild"
osource "D:/zephyrdev/zephyr/soc/ambiq/Kconfig.sysbuild"
osource "D:/zephyrdev/zephyr/soc/allwinner/sun8i_h3/Kconfig.sysbuild"
osource "D:/zephyrdev/zephyr/soc/alif/ensemble/Kconfig.sysbuild"
osource "D:/zephyrdev/zephyr/soc/aesc/Kconfig.sysbuild"
osource "D:/zephyrdev/zephyr/soc/adi/max32/Kconfig.sysbuild"
```
