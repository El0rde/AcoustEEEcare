## CMakeLists.txt
```
# SPDX-License-Identifier: Apache-2.0

cmake_minimum_required(VERSION 3.20.0)

find_package(Zephyr REQUIRED HINTS $ENV{ZEPHYR_BASE})
project(CAREM7)

zephyr_include_directories(
    ${ZEPHYR_BASE}/modules/hal/nordic/nrfx
    ${ZEPHYR_BASE}/modules/hal/nordic/nrfx/drivers/include
    ${ZEPHYR_BASE}/modules/hal/nordic/nrfx/mdk
    ${CMAKE_CURRENT_SOURCE_DIR}/src
)

# v7.2: generated MFCC tables (define heart/lung_mfcc_config + table arrays).
# v8.4: added src/tflm_inference.cc — TFLite Micro heart + lung inference.
#       Pulled in automatically: TFLM library + tensorflow/lite/... headers
#       via CONFIG_TENSORFLOW_LITE_MICRO=y; C++ via CONFIG_CPP/STD_CPP17.
target_sources(app PRIVATE
    src/main.c
    src/dsp_mfcc.c
    src/tflm_inference.cc          # ★ NEW
    src/generated/heart_mfcc_tables.c
    src/generated/lung_mfcc_tables.c
)

# Math (sinf/cosf/log10f/powf) — used by dsp_mfcc.c.
target_link_libraries(app PRIVATE m)
```

## Kconfig
```
# Copyright 2025 NXP
# SPDX-License-Identifier: Apache-2.0

source "Kconfig.zephyr"

config SAMPLE_BIT_WIDTH
	int "Sample bit width"
	default 32 if DT_HAS_NXP_MICFIL_ENABLED
	default 16
	help
	  PCM sample bit width.
```

## prj.conf
```kconfig
# ══════════════════════════════════════════════════════════════
# AcoustEEEcare v8.4 — BLE + one-capture DUAL inference
# (single-threaded; no SD card / no FATFS)
# ══════════════════════════════════════════════════════════════

CONFIG_GPIO=y

# ── BLE core ──────────────────────────────────────────────────
CONFIG_BT=y
CONFIG_BT_PERIPHERAL=y
CONFIG_BT_ZEPHYR_NUS=y
CONFIG_BT_DEVICE_NAME="AcoustEEEcare"

# ── MTU / ACL buffers ─────────────────────────────────────────
CONFIG_BT_L2CAP_TX_MTU=251
CONFIG_BT_BUF_ACL_TX_SIZE=251
CONFIG_BT_BUF_ACL_RX_SIZE=251
# Required: bt_gatt_exchange_mtu() lives in the GATT client code.
CONFIG_BT_GATT_CLIENT=y

# ── BLE throughput tuning ─────────────────────────────────────
CONFIG_BT_BUF_ACL_TX_COUNT=10
CONFIG_BT_BUF_EVT_RX_COUNT=11
CONFIG_BT_L2CAP_TX_BUF_COUNT=10
CONFIG_BT_ATT_PREPARE_COUNT=2

# ── Data Length Extension + 2M PHY ───────────────────────────
CONFIG_BT_CTLR_DATA_LENGTH_MAX=251
CONFIG_BT_USER_DATA_LEN_UPDATE=y
CONFIG_BT_CTLR_PHY_2M=y
CONFIG_BT_USER_PHY_UPDATE=y

# ── SAADC — nrfx direct ───────────────────────────────────────
CONFIG_NRFX_SAADC=y
CONFIG_ADC=n

# ── Logging / debugging ───────────────────────────────────────
CONFIG_LOG=y
CONFIG_LOG_DEFAULT_LEVEL=3      
CONFIG_PRINTK=y
CONFIG_STDOUT_CONSOLE=y
CONFIG_SERIAL=y
CONFIG_UART_CONSOLE=y
CONFIG_THREAD_NAME=y
CONFIG_THREAD_STACK_INFO=y
# HW stack protection via MPU (preferred over STACK_SENTINEL on nRF52840).
CONFIG_HW_STACK_PROTECTION=y

# ── Stack & heap ──────────────────────────────────────────────
# Main thread runs capture + MFCC + TFLM Invoke.
CONFIG_MAIN_STACK_SIZE=8192
CONFIG_SYSTEM_WORKQUEUE_STACK_SIZE=4096
CONFIG_BT_RX_STACK_SIZE=1536
# TFLM uses the static tensor_arena (in BSS), not the kernel heap;
# heap is only for BLE net_bufs.
CONFIG_HEAP_MEM_POOL_SIZE=4096

# ── Thread priority ───────────────────────────────────────────
CONFIG_MAIN_THREAD_PRIORITY=5

# ── FPU — required for CMSIS-DSP + TFLM float ops ─────────────
CONFIG_FPU=y
CONFIG_FPU_SHARING=y

# ── CMSIS-DSP (arm_math.h) ────────────────────────────────────
CONFIG_CMSIS_DSP=y
CONFIG_CMSIS_DSP_FILTERING=y   
CONFIG_CMSIS_DSP_TRANSFORM=y   
CONFIG_CMSIS_DSP_FASTMATH=y    

# ── Ring buffer ───────────────────────────────────────────────
CONFIG_RING_BUFFER=y

# ── C++ (required by TFLite Micro) ────────────────────────────
CONFIG_CPP=y
CONFIG_STD_CPP17=y
CONFIG_REQUIRES_FULL_LIBC=y

# ── TFLite Micro ──────────────────────────────────────────────
CONFIG_TENSORFLOW_LITE_MICRO=y
# CMSIS-NN kernels: large speedup on int8 CONV_2D / FULLY_CONNECTED.
CONFIG_TENSORFLOW_LITE_MICRO_CMSIS_NN_KERNELS=y

# Assertions on (catch TFLM / kernel misuse early during bring-up).
CONFIG_ASSERT=y
CONFIG_ASSERT_LEVEL=2
```

## boards/xiao_ble_nrf52840_sense.overlay
```dts
/*
 * SPDX-License-Identifier: Apache-2.0
 *
 * AcoustEEEcare v7.2 overlay — Seeed XIAO nRF52840 Sense
 *
 * CHANGES FROM v5.3:
 *   Removed &xiao_spi / sdhc0 / sdmmc-disk block entirely.
 *   SD card support was dropped in v6.7; keeping the DTS node
 *   without CONFIG_DISK_DRIVER_SDMMC=y / CONFIG_SPI=y caused
 *   a DTS binding error at build time ("no driver for compatible
 *   zephyr,sdmmc-disk found").
 *
 * SAADC (AIN0 / P0.02):
 *   nrfx_saadc accesses the SAADC peripheral directly.
 *   No DTS node is needed or appropriate when CONFIG_ADC=n.
 *
 * LEDs (led0=red, led1=green, led2=blue):
 *   Aliases are already defined in the upstream board DTS for
 *   xiao_ble / xiao_ble_sense.  No override needed here.
 *
 * This file is intentionally left with no active nodes.
 * It is kept so west build -b xiao_ble_nrf52840_sense can
 * reference it via boards/<board>.overlay without errors.
 */
```

## src/cnn_norm_stats.h
```c
/* cnn_norm_stats.h — per-coefficient z-score stats from CNN training.
 *
 * heart: cnn_results/cnn_norm_stats.npz   (25 coefficients)
 * lung:  lung_cnn_search/.../cnn_norm_stats.npz  (26 coefficients)
 *
 * Apply:  v = (coeff - mean[i]) / (std[i] + CNN_NORM_EPS)
 * BEFORE int8 quantization in heart_frame_cb and lung_frame_cb.
 *
 * The int8 input quantization scales (heart 0.396/zp38, lung 0.337/zp28)
 * were calibrated on NORMALIZED features.  Feeding raw MFCC values
 * causes the quantized inputs to land in the wrong range and the model
 * output to saturate at ~321 BPM.  This header fixes that.
 */
#ifndef CNN_NORM_STATS_H
#define CNN_NORM_STATS_H

#define CNN_NORM_EPS 1e-8f

/* ── Heart (25 coefficients) ─────────────────────────────────────── */
static const float heart_mfcc_mean[25] = {
    -39.99887f,  16.44387f,   7.44548f,   1.87824f,  -0.25391f,
     -0.43583f,   0.03216f,   0.28094f,   0.22963f,   0.01929f,
     -0.10588f,  -0.11651f,  -0.05044f,  -0.00097f,   0.01591f,
     -0.00197f,  -0.02068f,  -0.03133f,  -0.02724f,  -0.01735f,
     -0.00687f,  -0.00742f,  -0.00608f,  -0.00815f,  -0.00424f
};

static const float heart_mfcc_std[25] = {
      8.41331f,   3.01032f,   1.52634f,   1.75015f,   1.48996f,
      1.08274f,   0.91992f,   0.84160f,   0.75321f,   0.68056f,
      0.61896f,   0.56503f,   0.51448f,   0.46915f,   0.42906f,
      0.39057f,   0.35400f,   0.32480f,   0.30080f,   0.27495f,
      0.25527f,   0.24982f,   0.22503f,   0.22196f,   0.24233f
};

/* ── Lung (26 coefficients) ──────────────────────────────────────── */
static const float lung_mfcc_mean[26] = {
    -19.21439f,  19.46190f,  -7.15684f,   4.00321f,   0.00528f,
      0.16393f,   0.83603f,   0.15148f,   0.32986f,  -0.12560f,
      0.19978f,  -0.14356f,   0.06371f,  -0.05238f,   0.00675f,
      0.04725f,  -0.01417f,   0.02209f,   0.00533f,  -0.01905f,
     -0.04135f,  -0.03226f,   0.00532f,   0.04169f,  -0.00170f,
      0.03349f
};

static const float lung_mfcc_std[26] = {
      4.69837f,   2.33547f,   2.16953f,   1.40876f,   1.13252f,
      0.83434f,   0.69917f,   0.62863f,   0.59668f,   0.55600f,
      0.52916f,   0.50479f,   0.48703f,   0.45823f,   0.43214f,
      0.40609f,   0.37811f,   0.34997f,   0.32744f,   0.30237f,
      0.28253f,   0.26862f,   0.25542f,   0.25113f,   0.24119f,
      0.23850f
};

#endif /* CNN_NORM_STATS_H */
```

## src/dsp_mfcc.c
```c
/**
 * dsp_mfcc.c
 * ==========
 * Multi-instance, streaming DSP + MFCC pipeline. Zephyr/nRF52840.
 *
 * v7.2 — SCRATCH BUFFER & VALIDATION FIXES:
 *   - MAX_FFT_SIZE bumped 512 -> 2048 (lung config uses fft_size=2048)
 *   - MAX_N_FFT_BINS bumped 257 -> 1025 (= 2048/2 + 1)
 *   - dsp_mfcc_init() now hard-validates cfg against MAX_* constants.
 *     Previously, oversize configs silently overflowed BSS scratch.
 *   - Added one-time scratch-budget log at first init.
 *
 * v7.1 CIRCULAR-WINDOW OPTIMIZATION (unchanged):
 *   - Sliding window is a true circular buffer indexed by window_head.
 *   - Per-decimated-sample memmove eliminated.
 */

#include "dsp_mfcc.h"
#include <arm_math.h>
#include <string.h>
#include <math.h>
#include <zephyr/logging/log.h>

LOG_MODULE_REGISTER(dsp_mfcc);

/* ================================================================
 * SHARED SCRATCH BUFFERS
 *
 * v7.2: Sized for the largest config across heart and lung.
 *   Heart : fft_size=512, n_fft_bins=257, n_mel=25, n_mfcc=25
 *   Lung  : fft_size=2048, n_fft_bins=1025, n_mel=26, n_mfcc=26,
 *           frame_samples=1200
 *
 * Memory cost (~25 KB scratch, in BSS):
 *   bp_scratch  : 512 * 4 =  2,048 B
 *   fft_in      : 2048 * 4 = 8,192 B
 *   fft_out     : 2048 * 4 = 8,192 B
 *   power       : 1025 * 4 = 4,100 B
 *   mel_buf     : 30 * 4 =     120 B
 *   mfcc_out    : 30 * 4 =     120 B
 *                  total : 22,772 B
 * ================================================================ */
#define BP_SCRATCH_MAX   512
#define MAX_FFT_SIZE     2048
#define MAX_N_FFT_BINS   1025
#define MAX_N_MEL        30
#define MAX_N_MFCC       30

static float32_t bp_scratch[BP_SCRATCH_MAX];
static float32_t fft_in    [MAX_FFT_SIZE];
static float32_t fft_out   [MAX_FFT_SIZE];
static float32_t power     [MAX_N_FFT_BINS];
static float32_t mel_buf   [MAX_N_MEL];
static float32_t mfcc_out  [MAX_N_MFCC];

/* ================================================================
 * INTERNAL: compute one MFCC frame from the circular window.
 *
 * The window is filled in circular fashion. The OLDEST sample lives
 * at index window_head (it's the next slot to be overwritten). Reading
 * proceeds: window_head, window_head+1, ..., frame_samples-1,
 * 0, 1, ..., window_head-1.
 *
 * We read in at most two contiguous segments to keep the inner loop
 * tight.
 * ================================================================ */
static void compute_one_frame_streaming(dsp_mfcc_pipeline_t *p)
{
    const dsp_mfcc_config_t *cfg = p->cfg;
    const int frame_samples = cfg->frame_samples;
    const int fft_size      = cfg->fft_size;
    const int n_fft_bins    = cfg->n_fft_bins;
    const int n_mel         = cfg->n_mel;
    const int n_mfcc        = cfg->n_mfcc;
    const int16_t *win      = p->window;
    const float32_t *ham    = cfg->hamming;
    const int head          = p->window_head;

    /* Step 1: int16->float32 * Hamming, walking the ring in 2 segments.
     * Segment A: [head, frame_samples)  -> outputs fft_in[0 .. seg_a-1]
     * Segment B: [0, head)              -> outputs fft_in[seg_a .. frame_samples-1]
     */
    int seg_a = frame_samples - head;   /* may be == frame_samples if head==0 */
    int i, ham_i = 0;

    for (i = 0; i < seg_a; i++) {
        fft_in[ham_i] = ((float32_t)win[head + i] / 32768.0f) * ham[ham_i];
        ham_i++;
    }
    for (i = 0; i < head; i++) {
        fft_in[ham_i] = ((float32_t)win[i] / 32768.0f) * ham[ham_i];
        ham_i++;
    }

    /* Zero-pad to fft_size */
    memset(fft_in + frame_samples, 0,
           (fft_size - frame_samples) * sizeof(float32_t));

    /* Step 2: RFFT */
    arm_rfft_fast_f32(&p->rfft, fft_in, fft_out, 0);

    /* Step 3: power spectrum */
    power[0]              = fft_out[0] * fft_out[0];
    power[n_fft_bins - 1] = fft_out[1] * fft_out[1];
    for (int k = 1; k < n_fft_bins - 1; k++) {
        float32_t re = fft_out[2 * k];
        float32_t im = fft_out[2 * k + 1];
        power[k] = re * re + im * im;
    }

    /* Step 4 + 5: mel filterbank + log */
    for (int m = 0; m < n_mel; m++) {
        float32_t energy = 0.0f;
        const float32_t *row = cfg->mel_fb + m * n_fft_bins;
        for (int k = 0; k < n_fft_bins; k++) {
            energy += row[k] * power[k];
        }
        mel_buf[m] = logf(energy > 1e-6f ? energy : 1e-6f);
    }

    /* Step 6: DCT-II */
    for (int k = 0; k < n_mfcc; k++) {
        float32_t c = 0.0f;
        const float32_t *row = cfg->dct + k * n_mel;
        for (int n = 0; n < n_mel; n++) {
            c += row[n] * mel_buf[n];
        }
        mfcc_out[k] = c;
    }
}

/* ================================================================
 * PUBLIC: dsp_mfcc_init()
 *
 * v7.2: hard-validates cfg fields against compiled-in scratch limits.
 *       Returns negative errno on any violation -- caller MUST check.
 * ================================================================ */
int dsp_mfcc_init(dsp_mfcc_pipeline_t *p, const dsp_mfcc_config_t *cfg)
{
    if (!p || !cfg) {
        return -1;
    }

    /* ── v7.2: scratch-buffer bounds checks ─────────────────────── */
    if (cfg->frame_samples > MAX_FFT_SIZE) {
        LOG_ERR("frame_samples (%d) > MAX_FFT_SIZE (%d) -- "
                "increase MAX_FFT_SIZE in dsp_mfcc.c",
                cfg->frame_samples, MAX_FFT_SIZE);
        return -3;
    }
    if (cfg->fft_size > MAX_FFT_SIZE) {
        LOG_ERR("fft_size (%d) > MAX_FFT_SIZE (%d) -- "
                "increase MAX_FFT_SIZE in dsp_mfcc.c",
                cfg->fft_size, MAX_FFT_SIZE);
        return -4;
    }
    if (cfg->n_fft_bins > MAX_N_FFT_BINS) {
        LOG_ERR("n_fft_bins (%d) > MAX_N_FFT_BINS (%d) -- "
                "increase MAX_N_FFT_BINS in dsp_mfcc.c",
                cfg->n_fft_bins, MAX_N_FFT_BINS);
        return -5;
    }
    if (cfg->n_mel > MAX_N_MEL) {
        LOG_ERR("n_mel (%d) > MAX_N_MEL (%d) -- "
                "increase MAX_N_MEL in dsp_mfcc.c",
                cfg->n_mel, MAX_N_MEL);
        return -6;
    }
    if (cfg->n_mfcc > MAX_N_MFCC) {
        LOG_ERR("n_mfcc (%d) > MAX_N_MFCC (%d) -- "
                "increase MAX_N_MFCC in dsp_mfcc.c",
                cfg->n_mfcc, MAX_N_MFCC);
        return -7;
    }
    if (cfg->n_fft_bins != cfg->fft_size / 2 + 1) {
        LOG_ERR("n_fft_bins (%d) != fft_size/2 + 1 (%d) -- "
                "config self-inconsistent",
                cfg->n_fft_bins, cfg->fft_size / 2 + 1);
        return -8;
    }

    memset(p, 0, sizeof(*p));
    p->cfg = cfg;

    arm_biquad_cascade_df2T_init_f32(
        &p->bp_inst, BP_N_STAGES,
        (float32_t *)cfg->bp_coeffs, p->bp_state);

    arm_status st = arm_rfft_fast_init_f32(&p->rfft, (uint16_t)cfg->fft_size);
    if (st != ARM_MATH_SUCCESS) {
        LOG_ERR("arm_rfft_fast_init_f32 failed (fft_size=%d, status=%d) -- "
                "CMSIS-DSP needs CONFIG_CMSIS_DSP_TRANSFORM=y AND lookup "
                "tables compiled for that size",
                cfg->fft_size, (int)st);
        return -2;
    }

    LOG_INF("DSP+MFCC init OK: rate=%d frame=%d hop=%d fft=%d "
            "n_fft_bins=%d mel=%d mfcc=%d",
            cfg->target_rate, cfg->frame_samples, cfg->hop_samples,
            cfg->fft_size, cfg->n_fft_bins, cfg->n_mel, cfg->n_mfcc);
    return 0;
}

/* ================================================================
 * PUBLIC: dsp_mfcc_reset()
 * ================================================================ */
void dsp_mfcc_reset(dsp_mfcc_pipeline_t *p)
{
    const dsp_mfcc_config_t *cfg = p->cfg;

    memset(p->bp_state, 0, sizeof(p->bp_state));

    if (p->window) {
        memset(p->window, 0, cfg->frame_samples * sizeof(int16_t));
    }

    p->window_fill   = 0;
    p->window_head   = 0;
    p->decim_phase   = cfg->decimate_factor - 1;
    p->hop_counter   = cfg->frame_samples;
    p->frames_emitted = 0;
}

/* ================================================================
 * PUBLIC: dsp_mfcc_set_callback()
 * ================================================================ */
void dsp_mfcc_set_callback(dsp_mfcc_pipeline_t *p,
                           void (*cb)(int idx, const float *c, void *user),
                           void *user)
{
    p->frame_cb  = cb;
    p->user_data = user;
}

/* ================================================================
 * PUBLIC: dsp_mfcc_feed_chunk()
 *
 * Streaming with circular window:
 *   - decim_phase tracks decimation
 *   - each kept sample is written at window[window_head]; head++ mod frame_samples
 *   - window_fill saturates at frame_samples (so we know when we have
 *     a full window for the first time)
 *   - hop_counter decrements per decimated sample; frame fires when
 *     counter <= 0 and window is full
 * ================================================================ */
void dsp_mfcc_feed_chunk(dsp_mfcc_pipeline_t *p, const int16_t *pcm_8k, int n)
{
    const dsp_mfcc_config_t *cfg = p->cfg;
    const int frame_samples = cfg->frame_samples;

    if (n > BP_SCRATCH_MAX) {
        n = BP_SCRATCH_MAX;
    }

    /* int16 -> float32 */
    for (int i = 0; i < n; i++) {
        bp_scratch[i] = (float32_t)pcm_8k[i] / 32768.0f;
    }

    /* Bandpass in-place */
    arm_biquad_cascade_df2T_f32(&p->bp_inst, bp_scratch, bp_scratch,
                                (uint32_t)n);

    /* Decimate + circular window + frame trigger */
    for (int i = 0; i < n; i++) {
        p->decim_phase++;
        if (p->decim_phase < cfg->decimate_factor) {
            continue;
        }
        p->decim_phase = 0;

        int16_t s = (int16_t)(bp_scratch[i] * 32768.0f);

        /* Circular write -- O(1), no memmove */
        p->window[p->window_head] = s;
        p->window_head++;
        if (p->window_head >= frame_samples) {
            p->window_head = 0;
        }
        if (p->window_fill < frame_samples) {
            p->window_fill++;
        }

        p->hop_counter--;
        if (p->hop_counter <= 0 && p->window_fill == frame_samples) {
            compute_one_frame_streaming(p);

            if (p->frame_cb) {
                p->frame_cb(p->frames_emitted, mfcc_out, p->user_data);
            }

            p->frames_emitted++;
            p->hop_counter = cfg->hop_samples;
        }
    }
}

/* ================================================================
 * PUBLIC: dsp_mfcc_finish()
 * ================================================================ */
int dsp_mfcc_finish(dsp_mfcc_pipeline_t *p)
{
    if (!p || !p->cfg) {
        return -1;
    }

    LOG_INF("MFCC finish: %d frames emitted (expected %d), n_mfcc=%d",
            p->frames_emitted, p->cfg->n_frames_expected, p->cfg->n_mfcc);

    if (p->frames_emitted != p->cfg->n_frames_expected) {
        LOG_WRN("Frame count mismatch! got=%d expected=%d",
                p->frames_emitted, p->cfg->n_frames_expected);
    }

    return p->frames_emitted;
}
```

## src/dsp_mfcc.h
```c
/**
 * dsp_mfcc.h
 * ==========
 * Multi-instance DSP + MFCC pipeline for AcoustEEEcare on nRF52840/Zephyr.
 *
 * v7.1 CIRCULAR-WINDOW OPTIMIZATION:
 *   Adds window_head to the pipeline struct so the sliding window
 *   can be addressed as a circular buffer (no per-sample memmove).
 *   Public API unchanged from v7.0.
 */

#ifndef DSP_MFCC_H
#define DSP_MFCC_H

#include <stdint.h>
#include <arm_math.h>

/* ---- Universal constants (same for both pipelines) ---- */
#define DSP_SAMPLING_RATE    8000   /* 8 kHz SAADC capture rate */
#define HALF_BUF_SAMPLES     512    /* SAADC ping-pong half-buffer size */
#define BP_N_STAGES          4      /* Butterworth-4 -> 4 biquad sections */

/* ---- Pipeline configuration struct ---- */
typedef struct dsp_mfcc_config {
    /* Decimation */
    int decimate_factor;
    int target_rate;

    /* Frame structure */
    int frame_samples;
    int hop_samples;
    int n_frames_expected;

    /* FFT */
    int fft_size;
    int n_fft_bins;

    /* MFCC */
    int n_mel;
    int n_mfcc;
    float f_low_hz;
    float f_high_hz;

    /* Pointers to flash-constant tables */
    const float32_t *bp_coeffs;
    const float32_t *hamming;
    const float32_t *mel_fb;
    const float32_t *dct;
} dsp_mfcc_config_t;

/* ---- Pipeline state struct ---- */
typedef struct dsp_mfcc_pipeline {
    const dsp_mfcc_config_t *cfg;

    /* Bandpass biquad state */
    arm_biquad_cascade_df2T_instance_f32 bp_inst;
    float32_t bp_state[BP_N_STAGES * 2];

    /* FFT instance */
    arm_rfft_fast_instance_f32 rfft;

    /* Streaming state: circular window over decimated samples */
    int16_t  *window;       /* caller-allocated, size = cfg->frame_samples */
    int       window_fill;  /* samples currently in window (0..frame_samples) */
    int       window_head;  /* circular write index (0..frame_samples-1).
                             * Also points at OLDEST sample once window full,
                             * because that slot is the next to be overwritten. */
    int       hop_counter;  /* samples until next frame boundary */
    int       decim_phase;  /* decimation phase (0..decimate_factor-1) */

    /* Frame counter */
    int       frames_emitted;

    /* Per-frame callback */
    void    (*frame_cb)(int frame_idx, const float *coeffs, void *user);
    void     *user_data;
} dsp_mfcc_pipeline_t;

/* ---- Public API (unchanged from v7.0) ---- */
int  dsp_mfcc_init(dsp_mfcc_pipeline_t *p, const dsp_mfcc_config_t *cfg);
void dsp_mfcc_reset(dsp_mfcc_pipeline_t *p);
void dsp_mfcc_set_callback(dsp_mfcc_pipeline_t *p,
                           void (*cb)(int idx, const float *c, void *user),
                           void *user);
void dsp_mfcc_feed_chunk(dsp_mfcc_pipeline_t *p, const int16_t *pcm_8k, int n);
int  dsp_mfcc_finish(dsp_mfcc_pipeline_t *p);

#endif /* DSP_MFCC_H */
```

## src/heart_mfcc_config.h
```c
/**
 * heart_mfcc_config.h
 * ===================
 * Flash-constant table declarations and static config for the HEART pipeline.
 *
 * Heart MFCC parameters (from heart_winning_config.json):
 *   target_rate  = 2000 Hz  (decimate /4 from 8 kHz)
 *   frame_ms     = 30 ms    -> frame_samples = 60
 *   hop_pct      = 0.50     -> hop_samples   = 30
 *   fft_size     = 512      -> n_fft_bins    = 257
 *   num_mel      = 25
 *   num_mfcc     = 25
 *   n_frames     = 1 + (20000 - 60) / 30 = 665  (10 s @ 2 kHz)
 *   bandpass     = 10-200 Hz Butterworth-4 @ 8 kHz
 *   mel f_low    = 10 Hz, f_high = 1000 Hz (Nyquist of 2 kHz)
 *
 * The actual array contents are in src/generated/heart_mfcc_tables.c,
 * which is auto-generated by tools/gen_mfcc_tables.py. DO NOT hand-edit
 * the generated file.
 */

#ifndef HEART_MFCC_CONFIG_H
#define HEART_MFCC_CONFIG_H

#include "dsp_mfcc.h"
#include <arm_math.h>

/* Flash-constant tables -- generated by tools/gen_mfcc_tables.py */
extern const float32_t heart_bp_coeffs[BP_N_STAGES * 5]; /* SOS 10-200 Hz @ 8 kHz */
extern const float32_t heart_hamming[60];                 /* frame_samples = 60 */
extern const float32_t heart_mel_fb[25 * 257];            /* n_mel * n_fft_bins */
extern const float32_t heart_dct[25 * 25];                /* n_mfcc * n_mel */

/* Static config -- points to flash tables above */
extern const dsp_mfcc_config_t heart_mfcc_config;

#endif /* HEART_MFCC_CONFIG_H */
```

## src/hr_infer.cpp
```c
/*
 * hr_infer.cpp — Heart-Rate TFLite Micro inference
 * =================================================
 * Integrates HR_trial_144_int8.tflite into the AcoustEEEcare firmware.
 *
 * This file is C++ because TFLite Micro's public API is C++.
 * Your main.c calls it through the plain-C hr_infer.h interface.
 *
 * BUILD NOTE:
 *   Add to CMakeLists.txt:
 *     target_sources(app PRIVATE src/hr_infer.cpp)
 *   Zephyr's TFLM module handles include paths when
 *   CONFIG_TENSORFLOW_LITE_MICRO=y is set in prj.conf.
 */

#include "hr_infer.h"
#include "hr_model_data.h"   /* alignas(8) uint8_t hr_model_tflite[] */

/* TFLite Micro headers — provided by Zephyr's tflite-micro module */
#include <tensorflow/lite/micro/micro_interpreter.h>
#include <tensorflow/lite/micro/micro_mutable_op_resolver.h>
#include <tensorflow/lite/micro/system_setup.h>
#include <tensorflow/lite/schema/schema_generated.h>

#include <zephyr/logging/log.h>
#include <string.h>

LOG_MODULE_REGISTER(hr_infer);

/* ── Tensor arena ──────────────────────────────────────────────────
 * Start at 80 KB. After the first successful inference, read the
 * "Arena used: XXXXX bytes" log line printed by hr_infer_arena_used()
 * in main.c, then set this to that value + 4096 and rebuild.
 *
 * nRF52840 has 256 KB RAM total. With the rest of the firmware using
 * ~155 KB (kernel + BLE + DSP + MFCC buffer + rings), 80 KB fits
 * at ~235 KB total — just inside the limit. After trimming the arena
 * to the real minimum you will recover 20–35 KB of headroom.
 * ────────────────────────────────────────────────────────────────── */
#define TENSOR_ARENA_SIZE  (90 * 1024)

/* Static storage — no heap needed */
static uint8_t tensor_arena[TENSOR_ARENA_SIZE] __attribute__((aligned(16)));

/* Resolver: only the 4 op types used by this model */
using HRResolver = tflite::MicroMutableOpResolver<4>;
static HRResolver resolver;

/* Interpreter in static buffer — avoids heap/new */
alignas(tflite::MicroInterpreter)
static uint8_t interpreter_buf[sizeof(tflite::MicroInterpreter)];
static tflite::MicroInterpreter *interpreter = nullptr;

static const tflite::Model *model_ptr = nullptr;
static bool initialised = false;

/* ── Quantization helpers ──────────────────────────────────────── */

/*
 * float_to_int8_input() — quantize one float MFCC coefficient to INT8.
 * Formula: q = round(f / scale) + zero_point, clamped to [-128, 127].
 */
static inline int8_t float_to_int8_input(float f)
{
    float q = (f / HR_INPUT_SCALE) + (float)HR_INPUT_ZP;
    int32_t qi = (int32_t)(q >= 0.0f ? (q + 0.5f) : (q - 0.5f));
    if (qi < -128) qi = -128;
    if (qi >  127) qi =  127;
    return (int8_t)qi;
}

/*
 * int8_output_to_bpm() — dequantize the single INT8 output to BPM.
 * Params from model output quantization: scale=0.474156, zp=-128.
 * Range: 0.0 BPM (raw=-128) to ~120.9 BPM (raw=+127).
 */
static inline float int8_output_to_bpm(int8_t raw)
{
    return (float)((int32_t)raw - HR_OUTPUT_ZP) * HR_OUTPUT_SCALE;
}

/* ══════════════════════════════════════════════════════════════════
 * hr_infer_init()
 * ══════════════════════════════════════════════════════════════════ */
int hr_infer_init(void)
{
    tflite::InitializeTarget();

    model_ptr = tflite::GetModel(hr_model_tflite);
    if (model_ptr->version() != TFLITE_SCHEMA_VERSION) {
        LOG_ERR("HR model schema mismatch: model=%u runtime=%u",
                model_ptr->version(), TFLITE_SCHEMA_VERSION);
        return -1;
    }

    /*
     * Register ONLY the 4 ops this model uses.
     * Ops confirmed by flatbuffers inspection of HR_trial_144_int8.tflite:
     *   builtin_code 3  → CONV_2D
     *   builtin_code 17 → MAX_POOL_2D
     *   builtin_code 40 → MEAN  (used as GlobalAveragePooling)
     *   builtin_code 9  → FULLY_CONNECTED
     */
    resolver.AddConv2D();
    resolver.AddMaxPool2D();
    resolver.AddMean();
    resolver.AddFullyConnected();

    /* Placement-new into static buffer — no heap allocation */
    interpreter = new (interpreter_buf)
        tflite::MicroInterpreter(model_ptr, resolver,
                                 tensor_arena, TENSOR_ARENA_SIZE);

    if (interpreter->AllocateTensors() != kTfLiteOk) {
        LOG_ERR("HR model: AllocateTensors() failed — "
                "increase TENSOR_ARENA_SIZE (currently %d KB)",
                TENSOR_ARENA_SIZE / 1024);
        return -1;
    }

    /* Verify input/output shapes match our expectations */
    TfLiteTensor *in  = interpreter->input(0);
    TfLiteTensor *out = interpreter->output(0);

    bool shape_ok = (in->dims->size == 4)
                 && (in->dims->data[1] == HR_MODEL_FRAMES)
                 && (in->dims->data[2] == HR_MODEL_MFCC)
                 && (in->dims->data[3] == 1)
                 && (in->type == kTfLiteInt8)
                 && (out->dims->data[1] == 1)
                 && (out->type == kTfLiteInt8);

    if (!shape_ok) {
        LOG_ERR("HR model: unexpected tensor shape or type");
        LOG_ERR("  input  dims=%d [%d,%d,%d,%d] type=%d",
                in->dims->size,
                in->dims->data[0], in->dims->data[1],
                in->dims->data[2], in->dims->data[3],
                in->type);
        LOG_ERR("  output dims=%d [%d,%d] type=%d",
                out->dims->size,
                out->dims->data[0], out->dims->data[1],
                out->type);
        return -1;
    }

    initialised = true;
    LOG_INF("HR TFLite model ready | arena=%d KB | "
            "input=[1,%d,%d,1] INT8 | output=[1,1] INT8 | "
            "BPM range: 0.0–%.1f",
            TENSOR_ARENA_SIZE / 1024,
            HR_MODEL_FRAMES, HR_MODEL_MFCC,
            (double)int8_output_to_bpm(127));

    return 0;
}

/* ══════════════════════════════════════════════════════════════════
 * hr_infer_arena_used()
 *
 * Returns the number of tensor arena bytes actually used after
 * AllocateTensors() + Invoke(). Call this from main.c after a
 * successful hr_infer_run_int8() to find the real minimum arena size.
 * ══════════════════════════════════════════════════════════════════ */
uint32_t hr_infer_arena_used(void)
{
    if (!initialised || !interpreter) {
        return 0;
    }
    return (uint32_t)interpreter->arena_used_bytes();
}

/* ══════════════════════════════════════════════════════════════════
 * hr_infer_run()  — float input path
 * ══════════════════════════════════════════════════════════════════ */
int hr_infer_run(const float *mfcc_flat, int n_frames, hr_result_t *out)
{
    if (!initialised || !interpreter || !out) {
        LOG_ERR("hr_infer_run: not initialised");
        return -1;
    }

    TfLiteTensor *input_tensor = interpreter->input(0);
    int8_t *input_data = input_tensor->data.int8;

    int frames_to_copy = n_frames < HR_MODEL_FRAMES ? n_frames : HR_MODEL_FRAMES;

    for (int f = 0; f < frames_to_copy; f++) {
        for (int c = 0; c < HR_MODEL_MFCC; c++) {
            input_data[f * HR_MODEL_MFCC + c] =
                float_to_int8_input(mfcc_flat[f * HR_MODEL_MFCC + c]);
        }
    }

    /* Zero-pad remaining frames (0.0 float → HR_INPUT_ZP in INT8) */
    if (frames_to_copy < HR_MODEL_FRAMES) {
        int pad_start = frames_to_copy * HR_MODEL_MFCC;
        int pad_count = (HR_MODEL_FRAMES - frames_to_copy) * HR_MODEL_MFCC;
        memset(&input_data[pad_start], HR_INPUT_ZP, pad_count);
        LOG_WRN("hr_infer_run: only %d/%d frames — padded %d with silence",
                frames_to_copy, HR_MODEL_FRAMES,
                HR_MODEL_FRAMES - frames_to_copy);
    }

    if (interpreter->Invoke() != kTfLiteOk) {
        LOG_ERR("hr_infer_run: Invoke() failed");
        return -1;
    }

    TfLiteTensor *output_tensor = interpreter->output(0);
    int8_t raw = output_tensor->data.int8[0];

    out->raw_output = raw;
    out->bpm        = (double)int8_output_to_bpm(raw);

    LOG_INF("HR inference: raw_int8=%d → %.1f BPM", (int)raw, (double)out->bpm);
    return 0;
}

/* ══════════════════════════════════════════════════════════════════
 * hr_infer_run_int8()  — pre-quantized INT8 input path (preferred)
 *
 * main.c fills s_mfcc_flat_q8[] frame-by-frame during on_mfcc_frame(),
 * then passes the complete buffer here. We memcpy it straight into the
 * input tensor — no float conversion needed.
 * ══════════════════════════════════════════════════════════════════ */
int hr_infer_run_int8(const int8_t *mfcc_q8, int n_frames, hr_result_t *out)
{
    if (!initialised || !interpreter || !out) {
        LOG_ERR("hr_infer_run_int8: not initialised");
        return -1;
    }

    TfLiteTensor *input_tensor = interpreter->input(0);
    int8_t *input_data = input_tensor->data.int8;

    int frames_to_copy = n_frames < HR_MODEL_FRAMES ? n_frames : HR_MODEL_FRAMES;

    /* Copy pre-quantized data directly — no float conversion needed */
    memcpy(input_data,
           mfcc_q8,
           (size_t)frames_to_copy * HR_MODEL_MFCC * sizeof(int8_t));

    /* Zero-pad remaining frames using zero_point to represent 0.0 float */
    if (frames_to_copy < HR_MODEL_FRAMES) {
        int pad_start = frames_to_copy * HR_MODEL_MFCC;
        int pad_count = (HR_MODEL_FRAMES - frames_to_copy) * HR_MODEL_MFCC;
        memset(&input_data[pad_start], (uint8_t)HR_INPUT_ZP, pad_count);
        LOG_WRN("hr_infer_run_int8: padded %d frames with silence",
                HR_MODEL_FRAMES - frames_to_copy);
    }

    if (interpreter->Invoke() != kTfLiteOk) {
        LOG_ERR("hr_infer_run_int8: Invoke() failed");
        return -1;
    }

    TfLiteTensor *output_tensor = interpreter->output(0);
    int8_t raw = output_tensor->data.int8[0];

    out->raw_output = raw;
    out->bpm        = (double)int8_output_to_bpm(raw);

    LOG_INF("HR inference (int8): raw=%d → %.1f BPM", (int)raw, (double)out->bpm);
    return 0;
}
```

## src/hr_infer.h
```c
#pragma once
#include <stdint.h>

typedef struct {
    float    bpm;
    int8_t   raw_output;
} hr_result_t;

#define HR_MODEL_FRAMES   1331
#define HR_MODEL_MFCC     20
#define HR_MODEL_ELEMENTS (HR_MODEL_FRAMES * HR_MODEL_MFCC)

#define HR_INPUT_SCALE      0.06558491f
#define HR_INPUT_ZP         23
#define HR_OUTPUT_SCALE     0.47415614f
#define HR_OUTPUT_ZP        (-128)

#ifdef __cplusplus
extern "C" {
#endif

int      hr_infer_init(void);
int      hr_infer_run(const float *mfcc_flat, int n_frames, hr_result_t *out);
int      hr_infer_run_int8(const int8_t *mfcc_q8, int n_frames, hr_result_t *out);

/*
 * hr_infer_arena_used() — returns interpreter->arena_used_bytes().
 * Call after a successful hr_infer_run_int8() to find the real arena
 * floor. Set TENSOR_ARENA_SIZE = returned value + 4096 in hr_infer.cpp
 * and rebuild to recover RAM.
 * Returns 0 if called before hr_infer_init() succeeds.
 */
uint32_t hr_infer_arena_used(void);

#ifdef __cplusplus
}
#endif
```

## src/lung_mfcc_config.h
```c
/**
 * lung_mfcc_config.h
 * ==================
 * Flash-constant table declarations and static config for the LUNG pipeline.
 *
 * v2 — comments synced to actual generated tables and winning config.
 *
 * Lung MFCC parameters (from lung_winning_config.json — CURRENT):
 *   target_rate  = 4000 Hz  (decimate /2 from 8 kHz)
 *   frame_ms     = 300 ms   -> frame_samples = 1200
 *   hop_pct      = 0.10     -> hop_samples   = 120
 *   fft_size     = 2048     -> n_fft_bins    = 1025
 *   num_mel      = 26
 *   num_mfcc     = 26
 *   n_frames     = 1 + (40000 - 1200) / 120 = 324  (10 s @ 4 kHz)
 *   bandpass     = 100-1000 Hz Butterworth-4 @ 8 kHz
 *
 * The actual array contents are in src/generated/lung_mfcc_tables.c,
 * auto-generated by tools/gen_mfcc_tables.py. DO NOT hand-edit.
 *
 * If you regenerate the tables with different parameters, you MUST
 * update both the array dimensions below AND the lung_mfcc_config
 * struct values in lung_mfcc_tables.c (or wherever the struct is
 * defined). dsp_mfcc_init() validates the config at runtime and will
 * fail loudly if the dimensions disagree with the compiled-in
 * scratch buffer limits (MAX_FFT_SIZE etc. in dsp_mfcc.c).
 */

#ifndef LUNG_MFCC_CONFIG_H
#define LUNG_MFCC_CONFIG_H

#include "dsp_mfcc.h"
#include <arm_math.h>

/* Flash-constant tables -- generated by tools/gen_mfcc_tables.py */
extern const float32_t lung_bp_coeffs[BP_N_STAGES * 5]; /* SOS 100-1000 Hz @ 8 kHz */
extern const float32_t lung_hamming[1200];               /* frame_samples = 1200 */
extern const float32_t lung_mel_fb[26 * 1025];           /* n_mel * n_fft_bins */
extern const float32_t lung_dct[26 * 26];                /* n_mfcc * n_mel */

/* Static config -- points to flash tables above */
extern const dsp_mfcc_config_t lung_mfcc_config;

#endif /* LUNG_MFCC_CONFIG_H */
```

## src/tflm_inference.cc
```c
/*
 * tflm_inference.cc — TFLite Micro heart + lung inference (v3.2, BLE-only)
 * ========================================================================
 * Pre-quantized int8 features in, dequantized + clipped scalar out.
 * No SD / no filesystem. See tflm_inference.h for the contract.
 *
 * Models (verified): best_mcu_heart_int8.tflite / best_mcu_lung_int8.tflite
 *   HEART input [1,665,25,1] int8  output [1,1] int8  → HR, clip [40,180]
 *   LUNG  input [1,324,26,1] int8  output [1,1] int8  → RR, clip [6,50]
 *   Ops (both): CONV_2D, MAX_POOL_2D, MEAN, FULLY_CONNECTED.
 */

#include <string.h>
#include <errno.h>

#include <zephyr/kernel.h>
#include <zephyr/logging/log.h>

#include "tensorflow/lite/micro/micro_interpreter.h"
#include "tensorflow/lite/micro/micro_mutable_op_resolver.h"
#include "tensorflow/lite/schema/schema_generated.h"

#include "tflm_inference.h"
#include "heart_model.h"
#include "lung_model.h"

LOG_MODULE_REGISTER(tflm_inference, LOG_LEVEL_INF);

#define HEART_FRAMES 665
#define HEART_NMFCC   25
#define LUNG_FRAMES  324
#define LUNG_NMFCC    26

#define HEART_BPM_MIN  40.0f
#define HEART_BPM_MAX 180.0f
#define LUNG_RR_MIN     6.0f
#define LUNG_RR_MAX    50.0f

extern "C" volatile uint32_t g_tflm_arena_used_bytes;

/* Resolver: exactly the four ops both models use. */
using OpResolver = tflite::MicroMutableOpResolver<4>;
static int build_resolver(OpResolver &r)
{
    if (r.AddConv2D()         != kTfLiteOk) return -1;
    if (r.AddMaxPool2D()      != kTfLiteOk) return -1;
    if (r.AddMean()           != kTfLiteOk) return -1;
    if (r.AddFullyConnected() != kTfLiteOk) return -1;
    return 0;
}

static const uint8_t *model_for(int organ)
{
    return (organ == 1) ? g_lung_model_data : g_heart_model_data;
}

/* ── Probe input quantization (boot-time) ────────────────────────────── */
extern "C"
int tflm_get_input_quant(int organ, uint8_t *arena, size_t arena_bytes,
                         float *scale, int32_t *zero_point)
{
    const tflite::Model *model = tflite::GetModel(model_for(organ));
    if (model->version() != TFLITE_SCHEMA_VERSION) return -EINVAL;

    OpResolver resolver;
    if (build_resolver(resolver) != 0) return -ENOTSUP;

    tflite::MicroInterpreter interpreter(model, resolver, arena, arena_bytes);
    if (interpreter.AllocateTensors() != kTfLiteOk) return -ENOMEM;

    TfLiteTensor *input = interpreter.input(0);
    if (input == nullptr || input->type != kTfLiteInt8) return -EINVAL;

    *scale      = input->params.scale;
    *zero_point = input->params.zero_point;
    return 0;
}

/* ── Core int8 inference ─────────────────────────────────────────────── */
static int run_ram(int organ, const char *name,
                   uint8_t *arena, size_t arena_bytes,
                   const int8_t *features, int n_frames, int n_mfcc,
                   int exp_frames, int exp_mfcc, float *out_value)
{
    if (n_frames != exp_frames || n_mfcc != exp_mfcc) {
        LOG_ERR("%s: shape fw=[%d,%d] model=[%d,%d]",
                name, n_frames, n_mfcc, exp_frames, exp_mfcc);
        return -EINVAL;
    }

    const tflite::Model *model = tflite::GetModel(model_for(organ));
    if (model->version() != TFLITE_SCHEMA_VERSION) {
        LOG_ERR("%s: bad schema version", name);
        return -EINVAL;
    }

    OpResolver resolver;
    if (build_resolver(resolver) != 0) { LOG_ERR("%s: resolver", name); return -ENOTSUP; }

    tflite::MicroInterpreter interpreter(model, resolver, arena, arena_bytes);
    if (interpreter.AllocateTensors() != kTfLiteOk) {
        LOG_ERR("%s: AllocateTensors failed — arena too small? (%u B)",
                name, (unsigned)arena_bytes);
        return -ENOMEM;
    }

    const size_t used = interpreter.arena_used_bytes();
    g_tflm_arena_used_bytes = (uint32_t)used;
    LOG_INF("%s: arena used = %u / %u B", name, (unsigned)used, (unsigned)arena_bytes);

    TfLiteTensor *input = interpreter.input(0);
    if (input == nullptr || input->type != kTfLiteInt8) {
        LOG_ERR("%s: bad input tensor", name);
        return -EINVAL;
    }
    const size_t need = (size_t)n_frames * (size_t)n_mfcc;
    if (input->bytes != need) {
        LOG_ERR("%s: input bytes %u != %u", name, (unsigned)input->bytes, (unsigned)need);
        return -EINVAL;
    }

    /* Features are already quantized with this tensor's scale/zp. */
    memcpy(input->data.int8, features, need);

    int64_t t0 = k_uptime_get();
    if (interpreter.Invoke() != kTfLiteOk) { LOG_ERR("%s: Invoke failed", name); return -EIO; }
    LOG_INF("%s: inference %lld ms", name, k_uptime_delta(&t0));

    TfLiteTensor *output = interpreter.output(0);
    if (output == nullptr) return -EINVAL;

    float v;
    if (output->type == kTfLiteInt8) {
        v = ((float)((int32_t)output->data.int8[0] - output->params.zero_point))
            * output->params.scale;
    } else if (output->type == kTfLiteFloat32) {
        v = output->data.f[0];
    } else {
        LOG_ERR("%s: bad output type %d", name, output->type);
        return -EINVAL;
    }
    *out_value = v;
    LOG_INF("%s: raw output = %.3f", name, (double)v);
    return 0;
}

/* ── Public API ──────────────────────────────────────────────────────── */
extern "C"
void run_heart_inference_ram(uint8_t *arena, size_t arena_bytes,
                             const int8_t *features, int n_frames, int n_mfcc,
                             heart_result_t *result)
{
    memset(result, 0, sizeof(*result));
    result->class_idx = -1; result->confidence = 1.0f;
    float v = 0.0f;
    result->rc = run_ram(0, "heart", arena, arena_bytes, features,
                         n_frames, n_mfcc, HEART_FRAMES, HEART_NMFCC, &v);
    if (result->rc == 0) {
        if (v < HEART_BPM_MIN) v = HEART_BPM_MIN;
        if (v > HEART_BPM_MAX) v = HEART_BPM_MAX;
        result->value = v;
        LOG_INF("heart: HR = %.1f BPM", (double)v);
    }
}

extern "C"
void run_lung_inference_ram(uint8_t *arena, size_t arena_bytes,
                            const int8_t *features, int n_frames, int n_mfcc,
                            lung_result_t *result)
{
    memset(result, 0, sizeof(*result));
    result->class_idx = -1; result->confidence = 1.0f;
    float v = 0.0f;
    result->rc = run_ram(1, "lung", arena, arena_bytes, features,
                         n_frames, n_mfcc, LUNG_FRAMES, LUNG_NMFCC, &v);
    if (result->rc == 0) {
        if (v < LUNG_RR_MIN) v = LUNG_RR_MIN;
        if (v > LUNG_RR_MAX) v = LUNG_RR_MAX;
        result->value = v;
        LOG_INF("lung: RR = %.1f BPM", (double)v);
    }
}
```
