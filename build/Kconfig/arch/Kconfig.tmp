## build/Kconfig/arch/Kconfig.tmp
```kconfig
# Load Zephyr Arch Kconfig descriptions.
osource "D:/zephyrdev/zephyr/arch/rx/Kconfig"
osource "D:/zephyrdev/zephyr/arch/x86/Kconfig"
osource "D:/zephyrdev/zephyr/arch/xtensa/Kconfig"
osource "D:/zephyrdev/zephyr/arch/sparc/Kconfig"
osource "D:/zephyrdev/zephyr/arch/riscv/Kconfig"
osource "D:/zephyrdev/zephyr/arch/posix/Kconfig"
osource "D:/zephyrdev/zephyr/arch/openrisc/Kconfig"
osource "D:/zephyrdev/zephyr/arch/mips/Kconfig"
osource "D:/zephyrdev/zephyr/arch/arm64/Kconfig"
osource "D:/zephyrdev/zephyr/arch/arm/Kconfig"
osource "D:/zephyrdev/zephyr/arch/arc/Kconfig"
```

## build/Kconfig/boards/Kconfig.defconfig
```kconfig
# Load Zephyr board defconfig descriptions.
osource "D:/zephyrdev/zephyr/boards/seeed/xiao_ble/Kconfig.defconfig"
```

## build/Kconfig/boards/Kconfig.xiao_ble
```kconfig
# Load board Kconfig descriptions.
osource "D:/zephyrdev/zephyr/boards/seeed/xiao_ble/Kconfig.xiao_ble"
```

## build/Kconfig/soc/Kconfig
```kconfig
# Load Zephyr SoC Kconfig descriptions.
osource "D:/zephyrdev/zephyr/soc/xlnx/zynqmp/Kconfig"
osource "D:/zephyrdev/zephyr/soc/xlnx/zynq7000/Kconfig"
osource "D:/zephyrdev/zephyr/soc/xlnx/versalnet/Kconfig"
osource "D:/zephyrdev/zephyr/soc/xlnx/versal2/Kconfig"
osource "D:/zephyrdev/zephyr/soc/xlnx/versal/Kconfig"
osource "D:/zephyrdev/zephyr/soc/xen/Kconfig"
osource "D:/zephyrdev/zephyr/soc/wch/ch32v/Kconfig"
osource "D:/zephyrdev/zephyr/soc/ti/simplelink/Kconfig"
osource "D:/zephyrdev/zephyr/soc/ti/mspm0/Kconfig"
osource "D:/zephyrdev/zephyr/soc/ti/lm3s6965/Kconfig"
osource "D:/zephyrdev/zephyr/soc/ti/k3/Kconfig"
osource "D:/zephyrdev/zephyr/soc/telink/tlsr/Kconfig"
osource "D:/zephyrdev/zephyr/soc/syna/sr100/Kconfig"
osource "D:/zephyrdev/zephyr/soc/starfive/jh71xx/Kconfig"
osource "D:/zephyrdev/zephyr/soc/st/stm32/Kconfig"
osource "D:/zephyrdev/zephyr/soc/snps/qemu_arc/Kconfig"
osource "D:/zephyrdev/zephyr/soc/snps/nsim/arc_v/Kconfig"
osource "D:/zephyrdev/zephyr/soc/snps/nsim/arc_classic/Kconfig"
osource "D:/zephyrdev/zephyr/soc/snps/hsdk4xd/Kconfig"
osource "D:/zephyrdev/zephyr/soc/snps/hsdk/Kconfig"
osource "D:/zephyrdev/zephyr/soc/snps/emsk/Kconfig"
osource "D:/zephyrdev/zephyr/soc/snps/emsdp/Kconfig"
osource "D:/zephyrdev/zephyr/soc/snps/arc_iot/Kconfig"
osource "D:/zephyrdev/zephyr/soc/silabs/Kconfig"
osource "D:/zephyrdev/zephyr/soc/sifli/sf32/Kconfig"
osource "D:/zephyrdev/zephyr/soc/sifive/sifive_freedom/Kconfig"
osource "D:/zephyrdev/zephyr/soc/sensry/Kconfig"
osource "D:/zephyrdev/zephyr/soc/rockchip/Kconfig"
osource "D:/zephyrdev/zephyr/soc/renode/riscv_virtual/Kconfig"
osource "D:/zephyrdev/zephyr/soc/renode/cortex_r8_virtual/Kconfig"
osource "D:/zephyrdev/zephyr/soc/renesas/smartbond/Kconfig"
osource "D:/zephyrdev/zephyr/soc/renesas/rz/Kconfig"
osource "D:/zephyrdev/zephyr/soc/renesas/rx/Kconfig"
osource "D:/zephyrdev/zephyr/soc/renesas/rcar/Kconfig"
osource "D:/zephyrdev/zephyr/soc/renesas/ra/Kconfig"
osource "D:/zephyrdev/zephyr/soc/realtek/fingerprint/Kconfig"
osource "D:/zephyrdev/zephyr/soc/realtek/ec/Kconfig"
osource "D:/zephyrdev/zephyr/soc/realtek/bee/Kconfig"
osource "D:/zephyrdev/zephyr/soc/realtek/ameba/Kconfig"
osource "D:/zephyrdev/zephyr/soc/raspberrypi/rpi_pico/Kconfig"
osource "D:/zephyrdev/zephyr/soc/quicklogic/eos_s3/Kconfig"
osource "D:/zephyrdev/zephyr/soc/qemu/virt_riscv/Kconfig"
osource "D:/zephyrdev/zephyr/soc/qemu/or1k/Kconfig"
osource "D:/zephyrdev/zephyr/soc/qemu/malta/Kconfig"
osource "D:/zephyrdev/zephyr/soc/openisa/rv32m1/Kconfig"
osource "D:/zephyrdev/zephyr/soc/openhwgroup/cva6/Kconfig"
osource "D:/zephyrdev/zephyr/soc/oct/osd32mp15x/Kconfig"
osource "D:/zephyrdev/zephyr/soc/nxp/s32/Kconfig"
osource "D:/zephyrdev/zephyr/soc/nxp/rw/Kconfig"
osource "D:/zephyrdev/zephyr/soc/nxp/mcx/Kconfig"
osource "D:/zephyrdev/zephyr/soc/nxp/lpc/Kconfig"
osource "D:/zephyrdev/zephyr/soc/nxp/layerscape/Kconfig"
osource "D:/zephyrdev/zephyr/soc/nxp/kinetis/Kconfig"
osource "D:/zephyrdev/zephyr/soc/nxp/imxrt/Kconfig"
osource "D:/zephyrdev/zephyr/soc/nxp/imx/Kconfig"
osource "D:/zephyrdev/zephyr/soc/nuvoton/numicro/Kconfig"
osource "D:/zephyrdev/zephyr/soc/nuvoton/numaker/Kconfig"
osource "D:/zephyrdev/zephyr/soc/nuvoton/npcx/Kconfig"
osource "D:/zephyrdev/zephyr/soc/nuvoton/npcm/Kconfig"
osource "D:/zephyrdev/zephyr/soc/nordic/Kconfig"
osource "D:/zephyrdev/zephyr/soc/neorv32/Kconfig"
osource "D:/zephyrdev/zephyr/soc/native/inf_clock/Kconfig"
osource "D:/zephyrdev/zephyr/soc/microchip/sam/sama7/Kconfig"
osource "D:/zephyrdev/zephyr/soc/microchip/sam/sam_d5x_e5x/Kconfig"
osource "D:/zephyrdev/zephyr/soc/microchip/pic64/Kconfig"
osource "D:/zephyrdev/zephyr/soc/microchip/pic32c/pic32cz_ca/Kconfig"
osource "D:/zephyrdev/zephyr/soc/microchip/pic32c/pic32cx_sg/Kconfig"
osource "D:/zephyrdev/zephyr/soc/microchip/pic32c/pic32cm_pl/Kconfig"
osource "D:/zephyrdev/zephyr/soc/microchip/pic32c/pic32cm_jh/Kconfig"
osource "D:/zephyrdev/zephyr/soc/microchip/miv/Kconfig"
osource "D:/zephyrdev/zephyr/soc/microchip/mec/Kconfig"
osource "D:/zephyrdev/zephyr/soc/mediatek/mt8xxx/Kconfig"
osource "D:/zephyrdev/zephyr/soc/lowrisc/opentitan/Kconfig"
osource "D:/zephyrdev/zephyr/soc/litex/Kconfig"
osource "D:/zephyrdev/zephyr/soc/ite/ec/Kconfig"
osource "D:/zephyrdev/zephyr/soc/intel/wildcat_lake/Kconfig"
osource "D:/zephyrdev/zephyr/soc/intel/raptor_lake/Kconfig"
osource "D:/zephyrdev/zephyr/soc/intel/panther_lake/Kconfig"
osource "D:/zephyrdev/zephyr/soc/intel/lakemont/Kconfig"
osource "D:/zephyrdev/zephyr/soc/intel/intel_socfpga_std/Kconfig"
osource "D:/zephyrdev/zephyr/soc/intel/intel_socfpga/Kconfig"
osource "D:/zephyrdev/zephyr/soc/intel/intel_niosv/Kconfig"
osource "D:/zephyrdev/zephyr/soc/intel/intel_ish/Kconfig"
osource "D:/zephyrdev/zephyr/soc/intel/intel_adsp/Kconfig"
osource "D:/zephyrdev/zephyr/soc/intel/elkhart_lake/Kconfig"
osource "D:/zephyrdev/zephyr/soc/intel/atom/Kconfig"
osource "D:/zephyrdev/zephyr/soc/intel/apollo_lake/Kconfig"
osource "D:/zephyrdev/zephyr/soc/intel/alder_lake/Kconfig"
osource "D:/zephyrdev/zephyr/soc/infineon/psoc4/Kconfig"
osource "D:/zephyrdev/zephyr/soc/infineon/edge/Kconfig"
osource "D:/zephyrdev/zephyr/soc/infineon/cat3/Kconfig"
osource "D:/zephyrdev/zephyr/soc/infineon/cat1c/Kconfig"
osource "D:/zephyrdev/zephyr/soc/infineon/cat1b/Kconfig"
osource "D:/zephyrdev/zephyr/soc/infineon/cat1a/Kconfig"
osource "D:/zephyrdev/zephyr/soc/gd/gd32/Kconfig"
osource "D:/zephyrdev/zephyr/soc/gaisler/leon3/Kconfig"
osource "D:/zephyrdev/zephyr/soc/gaisler/gr716a/Kconfig"
osource "D:/zephyrdev/zephyr/soc/focaltech/Kconfig"
osource "D:/zephyrdev/zephyr/soc/espressif/Kconfig"
osource "D:/zephyrdev/zephyr/soc/ene/kb1200/Kconfig"
osource "D:/zephyrdev/zephyr/soc/ene/kb106x/Kconfig"
osource "D:/zephyrdev/zephyr/soc/elan/em32f967/Kconfig"
osource "D:/zephyrdev/zephyr/soc/egis/Kconfig"
osource "D:/zephyrdev/zephyr/soc/efinix/sapphire/Kconfig"
osource "D:/zephyrdev/zephyr/soc/cdns/xtensa_sample_controller/Kconfig"
osource "D:/zephyrdev/zephyr/soc/cdns/swerv/Kconfig"
osource "D:/zephyrdev/zephyr/soc/cdns/sample_controller32/Kconfig"
osource "D:/zephyrdev/zephyr/soc/cdns/dc233c/Kconfig"
osource "D:/zephyrdev/zephyr/soc/brcm/bcmvk/Kconfig"
osource "D:/zephyrdev/zephyr/soc/brcm/bcm2712/Kconfig"
osource "D:/zephyrdev/zephyr/soc/brcm/bcm2711/Kconfig"
osource "D:/zephyrdev/zephyr/soc/blackberry/qnxhv_vm/Kconfig"
osource "D:/zephyrdev/zephyr/soc/bflb/Kconfig"
osource "D:/zephyrdev/zephyr/soc/atmel/sam0/Kconfig"
osource "D:/zephyrdev/zephyr/soc/atmel/sam/Kconfig"
osource "D:/zephyrdev/zephyr/soc/aspeed/Kconfig"
osource "D:/zephyrdev/zephyr/soc/arm/Kconfig"
osource "D:/zephyrdev/zephyr/soc/arm/beetle/Kconfig"
osource "D:/zephyrdev/zephyr/soc/antmicro/myra/Kconfig"
osource "D:/zephyrdev/zephyr/soc/andestech/Kconfig"
osource "D:/zephyrdev/zephyr/soc/amd/acp_7_0/Kconfig"
osource "D:/zephyrdev/zephyr/soc/amd/acp_6_0/Kconfig"
osource "D:/zephyrdev/zephyr/soc/ambiq/Kconfig"
osource "D:/zephyrdev/zephyr/soc/allwinner/sun8i_h3/Kconfig"
osource "D:/zephyrdev/zephyr/soc/alif/ensemble/Kconfig"
osource "D:/zephyrdev/zephyr/soc/aesc/Kconfig"
osource "D:/zephyrdev/zephyr/soc/adi/max32/Kconfig"
```
