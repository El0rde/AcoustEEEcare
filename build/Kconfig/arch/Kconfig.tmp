## build/Kconfig/soc/Kconfig.defconfig
```kconfig
# Load Zephyr SoC defconfig descriptions.
osource "D:/zephyrdev/zephyr/soc/xlnx/zynqmp/Kconfig.defconfig"
osource "D:/zephyrdev/zephyr/soc/xlnx/zynq7000/Kconfig.defconfig"
osource "D:/zephyrdev/zephyr/soc/xlnx/versalnet/Kconfig.defconfig"
osource "D:/zephyrdev/zephyr/soc/xlnx/versal2/Kconfig.defconfig"
osource "D:/zephyrdev/zephyr/soc/xlnx/versal/Kconfig.defconfig"
osource "D:/zephyrdev/zephyr/soc/xen/Kconfig.defconfig"
osource "D:/zephyrdev/zephyr/soc/wch/ch32v/Kconfig.defconfig"
osource "D:/zephyrdev/zephyr/soc/ti/simplelink/Kconfig.defconfig"
osource "D:/zephyrdev/zephyr/soc/ti/mspm0/Kconfig.defconfig"
osource "D:/zephyrdev/zephyr/soc/ti/lm3s6965/Kconfig.defconfig"
osource "D:/zephyrdev/zephyr/soc/ti/k3/Kconfig.defconfig"
osource "D:/zephyrdev/zephyr/soc/telink/tlsr/Kconfig.defconfig"
osource "D:/zephyrdev/zephyr/soc/syna/sr100/Kconfig.defconfig"
osource "D:/zephyrdev/zephyr/soc/starfive/jh71xx/Kconfig.defconfig"
osource "D:/zephyrdev/zephyr/soc/st/stm32/Kconfig.defconfig"
osource "D:/zephyrdev/zephyr/soc/snps/qemu_arc/Kconfig.defconfig"
osource "D:/zephyrdev/zephyr/soc/snps/nsim/arc_v/Kconfig.defconfig"
osource "D:/zephyrdev/zephyr/soc/snps/nsim/arc_classic/Kconfig.defconfig"
osource "D:/zephyrdev/zephyr/soc/snps/hsdk4xd/Kconfig.defconfig"
osource "D:/zephyrdev/zephyr/soc/snps/hsdk/Kconfig.defconfig"
osource "D:/zephyrdev/zephyr/soc/snps/emsk/Kconfig.defconfig"
osource "D:/zephyrdev/zephyr/soc/snps/emsdp/Kconfig.defconfig"
osource "D:/zephyrdev/zephyr/soc/snps/arc_iot/Kconfig.defconfig"
osource "D:/zephyrdev/zephyr/soc/silabs/Kconfig.defconfig"
osource "D:/zephyrdev/zephyr/soc/sifli/sf32/Kconfig.defconfig"
osource "D:/zephyrdev/zephyr/soc/sifive/sifive_freedom/Kconfig.defconfig"
osource "D:/zephyrdev/zephyr/soc/sensry/Kconfig.defconfig"
osource "D:/zephyrdev/zephyr/soc/rockchip/Kconfig.defconfig"
osource "D:/zephyrdev/zephyr/soc/renode/riscv_virtual/Kconfig.defconfig"
osource "D:/zephyrdev/zephyr/soc/renode/cortex_r8_virtual/Kconfig.defconfig"
osource "D:/zephyrdev/zephyr/soc/renesas/smartbond/Kconfig.defconfig"
osource "D:/zephyrdev/zephyr/soc/renesas/rz/Kconfig.defconfig"
osource "D:/zephyrdev/zephyr/soc/renesas/rx/Kconfig.defconfig"
osource "D:/zephyrdev/zephyr/soc/renesas/rcar/Kconfig.defconfig"
osource "D:/zephyrdev/zephyr/soc/renesas/ra/Kconfig.defconfig"
osource "D:/zephyrdev/zephyr/soc/realtek/fingerprint/Kconfig.defconfig"
osource "D:/zephyrdev/zephyr/soc/realtek/ec/Kconfig.defconfig"
osource "D:/zephyrdev/zephyr/soc/realtek/bee/Kconfig.defconfig"
osource "D:/zephyrdev/zephyr/soc/realtek/ameba/Kconfig.defconfig"
osource "D:/zephyrdev/zephyr/soc/raspberrypi/rpi_pico/Kconfig.defconfig"
osource "D:/zephyrdev/zephyr/soc/quicklogic/eos_s3/Kconfig.defconfig"
osource "D:/zephyrdev/zephyr/soc/qemu/virt_riscv/Kconfig.defconfig"
osource "D:/zephyrdev/zephyr/soc/qemu/or1k/Kconfig.defconfig"
osource "D:/zephyrdev/zephyr/soc/qemu/malta/Kconfig.defconfig"
osource "D:/zephyrdev/zephyr/soc/openisa/rv32m1/Kconfig.defconfig"
osource "D:/zephyrdev/zephyr/soc/openhwgroup/cva6/Kconfig.defconfig"
osource "D:/zephyrdev/zephyr/soc/oct/osd32mp15x/Kconfig.defconfig"
osource "D:/zephyrdev/zephyr/soc/nxp/s32/Kconfig.defconfig"
osource "D:/zephyrdev/zephyr/soc/nxp/rw/Kconfig.defconfig"
osource "D:/zephyrdev/zephyr/soc/nxp/mcx/Kconfig.defconfig"
osource "D:/zephyrdev/zephyr/soc/nxp/lpc/Kconfig.defconfig"
osource "D:/zephyrdev/zephyr/soc/nxp/layerscape/Kconfig.defconfig"
osource "D:/zephyrdev/zephyr/soc/nxp/kinetis/Kconfig.defconfig"
osource "D:/zephyrdev/zephyr/soc/nxp/imxrt/Kconfig.defconfig"
osource "D:/zephyrdev/zephyr/soc/nxp/imx/Kconfig.defconfig"
osource "D:/zephyrdev/zephyr/soc/nuvoton/numicro/Kconfig.defconfig"
osource "D:/zephyrdev/zephyr/soc/nuvoton/numaker/Kconfig.defconfig"
osource "D:/zephyrdev/zephyr/soc/nuvoton/npcx/Kconfig.defconfig"
osource "D:/zephyrdev/zephyr/soc/nuvoton/npcm/Kconfig.defconfig"
osource "D:/zephyrdev/zephyr/soc/nordic/Kconfig.defconfig"
osource "D:/zephyrdev/zephyr/soc/neorv32/Kconfig.defconfig"
osource "D:/zephyrdev/zephyr/soc/native/inf_clock/Kconfig.defconfig"
osource "D:/zephyrdev/zephyr/soc/microchip/sam/sama7/Kconfig.defconfig"
osource "D:/zephyrdev/zephyr/soc/microchip/sam/sam_d5x_e5x/Kconfig.defconfig"
osource "D:/zephyrdev/zephyr/soc/microchip/pic64/Kconfig.defconfig"
osource "D:/zephyrdev/zephyr/soc/microchip/pic32c/pic32cz_ca/Kconfig.defconfig"
osource "D:/zephyrdev/zephyr/soc/microchip/pic32c/pic32cx_sg/Kconfig.defconfig"
osource "D:/zephyrdev/zephyr/soc/microchip/pic32c/pic32cm_pl/Kconfig.defconfig"
osource "D:/zephyrdev/zephyr/soc/microchip/pic32c/pic32cm_jh/Kconfig.defconfig"
osource "D:/zephyrdev/zephyr/soc/microchip/miv/Kconfig.defconfig"
osource "D:/zephyrdev/zephyr/soc/microchip/mec/Kconfig.defconfig"
osource "D:/zephyrdev/zephyr/soc/mediatek/mt8xxx/Kconfig.defconfig"
osource "D:/zephyrdev/zephyr/soc/lowrisc/opentitan/Kconfig.defconfig"
osource "D:/zephyrdev/zephyr/soc/litex/Kconfig.defconfig"
osource "D:/zephyrdev/zephyr/soc/ite/ec/Kconfig.defconfig"
osource "D:/zephyrdev/zephyr/soc/intel/wildcat_lake/Kconfig.defconfig"
osource "D:/zephyrdev/zephyr/soc/intel/raptor_lake/Kconfig.defconfig"
osource "D:/zephyrdev/zephyr/soc/intel/panther_lake/Kconfig.defconfig"
osource "D:/zephyrdev/zephyr/soc/intel/lakemont/Kconfig.defconfig"
osource "D:/zephyrdev/zephyr/soc/intel/intel_socfpga_std/Kconfig.defconfig"
osource "D:/zephyrdev/zephyr/soc/intel/intel_socfpga/Kconfig.defconfig"
osource "D:/zephyrdev/zephyr/soc/intel/intel_niosv/Kconfig.defconfig"
osource "D:/zephyrdev/zephyr/soc/intel/intel_ish/Kconfig.defconfig"
osource "D:/zephyrdev/zephyr/soc/intel/intel_adsp/Kconfig.defconfig"
osource "D:/zephyrdev/zephyr/soc/intel/elkhart_lake/Kconfig.defconfig"
osource "D:/zephyrdev/zephyr/soc/intel/atom/Kconfig.defconfig"
osource "D:/zephyrdev/zephyr/soc/intel/apollo_lake/Kconfig.defconfig"
osource "D:/zephyrdev/zephyr/soc/intel/alder_lake/Kconfig.defconfig"
osource "D:/zephyrdev/zephyr/soc/infineon/psoc4/Kconfig.defconfig"
osource "D:/zephyrdev/zephyr/soc/infineon/edge/Kconfig.defconfig"
osource "D:/zephyrdev/zephyr/soc/infineon/cat3/Kconfig.defconfig"
osource "D:/zephyrdev/zephyr/soc/infineon/cat1c/Kconfig.defconfig"
osource "D:/zephyrdev/zephyr/soc/infineon/cat1b/Kconfig.defconfig"
osource "D:/zephyrdev/zephyr/soc/infineon/cat1a/Kconfig.defconfig"
osource "D:/zephyrdev/zephyr/soc/gd/gd32/Kconfig.defconfig"
osource "D:/zephyrdev/zephyr/soc/gaisler/leon3/Kconfig.defconfig"
osource "D:/zephyrdev/zephyr/soc/gaisler/gr716a/Kconfig.defconfig"
osource "D:/zephyrdev/zephyr/soc/focaltech/Kconfig.defconfig"
osource "D:/zephyrdev/zephyr/soc/espressif/Kconfig.defconfig"
osource "D:/zephyrdev/zephyr/soc/ene/kb1200/Kconfig.defconfig"
osource "D:/zephyrdev/zephyr/soc/ene/kb106x/Kconfig.defconfig"
osource "D:/zephyrdev/zephyr/soc/elan/em32f967/Kconfig.defconfig"
osource "D:/zephyrdev/zephyr/soc/egis/Kconfig.defconfig"
osource "D:/zephyrdev/zephyr/soc/efinix/sapphire/Kconfig.defconfig"
osource "D:/zephyrdev/zephyr/soc/cdns/xtensa_sample_controller/Kconfig.defconfig"
osource "D:/zephyrdev/zephyr/soc/cdns/swerv/Kconfig.defconfig"
osource "D:/zephyrdev/zephyr/soc/cdns/sample_controller32/Kconfig.defconfig"
osource "D:/zephyrdev/zephyr/soc/cdns/dc233c/Kconfig.defconfig"
osource "D:/zephyrdev/zephyr/soc/brcm/bcmvk/Kconfig.defconfig"
osource "D:/zephyrdev/zephyr/soc/brcm/bcm2712/Kconfig.defconfig"
osource "D:/zephyrdev/zephyr/soc/brcm/bcm2711/Kconfig.defconfig"
osource "D:/zephyrdev/zephyr/soc/blackberry/qnxhv_vm/Kconfig.defconfig"
osource "D:/zephyrdev/zephyr/soc/bflb/Kconfig.defconfig"
osource "D:/zephyrdev/zephyr/soc/atmel/sam0/Kconfig.defconfig"
osource "D:/zephyrdev/zephyr/soc/atmel/sam/Kconfig.defconfig"
osource "D:/zephyrdev/zephyr/soc/aspeed/Kconfig.defconfig"
osource "D:/zephyrdev/zephyr/soc/arm/Kconfig.defconfig"
osource "D:/zephyrdev/zephyr/soc/arm/beetle/Kconfig.defconfig"
osource "D:/zephyrdev/zephyr/soc/antmicro/myra/Kconfig.defconfig"
osource "D:/zephyrdev/zephyr/soc/andestech/Kconfig.defconfig"
osource "D:/zephyrdev/zephyr/soc/amd/acp_7_0/Kconfig.defconfig"
osource "D:/zephyrdev/zephyr/soc/amd/acp_6_0/Kconfig.defconfig"
osource "D:/zephyrdev/zephyr/soc/ambiq/Kconfig.defconfig"
osource "D:/zephyrdev/zephyr/soc/allwinner/sun8i_h3/Kconfig.defconfig"
osource "D:/zephyrdev/zephyr/soc/alif/ensemble/Kconfig.defconfig"
osource "D:/zephyrdev/zephyr/soc/aesc/Kconfig.defconfig"
osource "D:/zephyrdev/zephyr/soc/adi/max32/Kconfig.defconfig"
```
