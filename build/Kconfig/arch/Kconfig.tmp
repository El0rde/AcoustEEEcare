## build/Kconfig/soc/Kconfig.soc.tmp
```kconfig
# Load SoC Kconfig descriptions.
osource "D:/zephyrdev/zephyr/soc/xlnx/zynqmp/Kconfig.soc"
osource "D:/zephyrdev/zephyr/soc/xlnx/zynq7000/Kconfig.soc"
osource "D:/zephyrdev/zephyr/soc/xlnx/versalnet/Kconfig.soc"
osource "D:/zephyrdev/zephyr/soc/xlnx/versal2/Kconfig.soc"
osource "D:/zephyrdev/zephyr/soc/xlnx/versal/Kconfig.soc"
osource "D:/zephyrdev/zephyr/soc/xen/Kconfig.soc"
osource "D:/zephyrdev/zephyr/soc/wch/ch32v/Kconfig.soc"
osource "D:/zephyrdev/zephyr/soc/ti/simplelink/Kconfig.soc"
osource "D:/zephyrdev/zephyr/soc/ti/mspm0/Kconfig.soc"
osource "D:/zephyrdev/zephyr/soc/ti/lm3s6965/Kconfig.soc"
osource "D:/zephyrdev/zephyr/soc/ti/k3/Kconfig.soc"
osource "D:/zephyrdev/zephyr/soc/telink/tlsr/Kconfig.soc"
osource "D:/zephyrdev/zephyr/soc/syna/sr100/Kconfig.soc"
osource "D:/zephyrdev/zephyr/soc/starfive/jh71xx/Kconfig.soc"
osource "D:/zephyrdev/zephyr/soc/st/stm32/Kconfig.soc"
osource "D:/zephyrdev/zephyr/soc/snps/qemu_arc/Kconfig.soc"
osource "D:/zephyrdev/zephyr/soc/snps/nsim/arc_v/Kconfig.soc"
osource "D:/zephyrdev/zephyr/soc/snps/nsim/arc_classic/Kconfig.soc"
osource "D:/zephyrdev/zephyr/soc/snps/hsdk4xd/Kconfig.soc"
osource "D:/zephyrdev/zephyr/soc/snps/hsdk/Kconfig.soc"
osource "D:/zephyrdev/zephyr/soc/snps/emsk/Kconfig.soc"
osource "D:/zephyrdev/zephyr/soc/snps/emsdp/Kconfig.soc"
osource "D:/zephyrdev/zephyr/soc/snps/arc_iot/Kconfig.soc"
osource "D:/zephyrdev/zephyr/soc/silabs/Kconfig.soc"
osource "D:/zephyrdev/zephyr/soc/sifli/sf32/Kconfig.soc"
osource "D:/zephyrdev/zephyr/soc/sifive/sifive_freedom/Kconfig.soc"
osource "D:/zephyrdev/zephyr/soc/sensry/Kconfig.soc"
osource "D:/zephyrdev/zephyr/soc/rockchip/Kconfig.soc"
osource "D:/zephyrdev/zephyr/soc/renode/riscv_virtual/Kconfig.soc"
osource "D:/zephyrdev/zephyr/soc/renode/cortex_r8_virtual/Kconfig.soc"
osource "D:/zephyrdev/zephyr/soc/renesas/smartbond/Kconfig.soc"
osource "D:/zephyrdev/zephyr/soc/renesas/rz/Kconfig.soc"
osource "D:/zephyrdev/zephyr/soc/renesas/rx/Kconfig.soc"
osource "D:/zephyrdev/zephyr/soc/renesas/rcar/Kconfig.soc"
osource "D:/zephyrdev/zephyr/soc/renesas/ra/Kconfig.soc"
osource "D:/zephyrdev/zephyr/soc/realtek/fingerprint/Kconfig.soc"
osource "D:/zephyrdev/zephyr/soc/realtek/ec/Kconfig.soc"
osource "D:/zephyrdev/zephyr/soc/realtek/bee/Kconfig.soc"
osource "D:/zephyrdev/zephyr/soc/realtek/ameba/Kconfig.soc"
osource "D:/zephyrdev/zephyr/soc/raspberrypi/rpi_pico/Kconfig.soc"
osource "D:/zephyrdev/zephyr/soc/quicklogic/eos_s3/Kconfig.soc"
osource "D:/zephyrdev/zephyr/soc/qemu/virt_riscv/Kconfig.soc"
osource "D:/zephyrdev/zephyr/soc/qemu/or1k/Kconfig.soc"
osource "D:/zephyrdev/zephyr/soc/qemu/malta/Kconfig.soc"
osource "D:/zephyrdev/zephyr/soc/openisa/rv32m1/Kconfig.soc"
osource "D:/zephyrdev/zephyr/soc/openhwgroup/cva6/Kconfig.soc"
osource "D:/zephyrdev/zephyr/soc/oct/osd32mp15x/Kconfig.soc"
osource "D:/zephyrdev/zephyr/soc/nxp/s32/Kconfig.soc"
osource "D:/zephyrdev/zephyr/soc/nxp/rw/Kconfig.soc"
osource "D:/zephyrdev/zephyr/soc/nxp/mcx/Kconfig.soc"
osource "D:/zephyrdev/zephyr/soc/nxp/lpc/Kconfig.soc"
osource "D:/zephyrdev/zephyr/soc/nxp/layerscape/Kconfig.soc"
osource "D:/zephyrdev/zephyr/soc/nxp/kinetis/Kconfig.soc"
osource "D:/zephyrdev/zephyr/soc/nxp/imxrt/Kconfig.soc"
osource "D:/zephyrdev/zephyr/soc/nxp/imx/Kconfig.soc"
osource "D:/zephyrdev/zephyr/soc/nuvoton/numicro/Kconfig.soc"
osource "D:/zephyrdev/zephyr/soc/nuvoton/numaker/Kconfig.soc"
osource "D:/zephyrdev/zephyr/soc/nuvoton/npcx/Kconfig.soc"
osource "D:/zephyrdev/zephyr/soc/nuvoton/npcm/Kconfig.soc"
osource "D:/zephyrdev/zephyr/soc/nordic/Kconfig.soc"
osource "D:/zephyrdev/zephyr/soc/neorv32/Kconfig.soc"
osource "D:/zephyrdev/zephyr/soc/native/inf_clock/Kconfig.soc"
osource "D:/zephyrdev/zephyr/soc/microchip/sam/sama7/Kconfig.soc"
osource "D:/zephyrdev/zephyr/soc/microchip/sam/sam_d5x_e5x/Kconfig.soc"
osource "D:/zephyrdev/zephyr/soc/microchip/pic64/Kconfig.soc"
osource "D:/zephyrdev/zephyr/soc/microchip/pic32c/pic32cz_ca/Kconfig.soc"
osource "D:/zephyrdev/zephyr/soc/microchip/pic32c/pic32cx_sg/Kconfig.soc"
osource "D:/zephyrdev/zephyr/soc/microchip/pic32c/pic32cm_pl/Kconfig.soc"
osource "D:/zephyrdev/zephyr/soc/microchip/pic32c/pic32cm_jh/Kconfig.soc"
osource "D:/zephyrdev/zephyr/soc/microchip/miv/Kconfig.soc"
osource "D:/zephyrdev/zephyr/soc/microchip/mec/Kconfig.soc"
osource "D:/zephyrdev/zephyr/soc/mediatek/mt8xxx/Kconfig.soc"
osource "D:/zephyrdev/zephyr/soc/lowrisc/opentitan/Kconfig.soc"
osource "D:/zephyrdev/zephyr/soc/litex/Kconfig.soc"
osource "D:/zephyrdev/zephyr/soc/ite/ec/Kconfig.soc"
osource "D:/zephyrdev/zephyr/soc/intel/wildcat_lake/Kconfig.soc"
osource "D:/zephyrdev/zephyr/soc/intel/raptor_lake/Kconfig.soc"
osource "D:/zephyrdev/zephyr/soc/intel/panther_lake/Kconfig.soc"
osource "D:/zephyrdev/zephyr/soc/intel/lakemont/Kconfig.soc"
osource "D:/zephyrdev/zephyr/soc/intel/intel_socfpga_std/Kconfig.soc"
osource "D:/zephyrdev/zephyr/soc/intel/intel_socfpga/Kconfig.soc"
osource "D:/zephyrdev/zephyr/soc/intel/intel_niosv/Kconfig.soc"
osource "D:/zephyrdev/zephyr/soc/intel/intel_ish/Kconfig.soc"
osource "D:/zephyrdev/zephyr/soc/intel/intel_adsp/Kconfig.soc"
osource "D:/zephyrdev/zephyr/soc/intel/elkhart_lake/Kconfig.soc"
osource "D:/zephyrdev/zephyr/soc/intel/atom/Kconfig.soc"
osource "D:/zephyrdev/zephyr/soc/intel/apollo_lake/Kconfig.soc"
osource "D:/zephyrdev/zephyr/soc/intel/alder_lake/Kconfig.soc"
osource "D:/zephyrdev/zephyr/soc/infineon/psoc4/Kconfig.soc"
osource "D:/zephyrdev/zephyr/soc/infineon/edge/Kconfig.soc"
osource "D:/zephyrdev/zephyr/soc/infineon/cat3/Kconfig.soc"
osource "D:/zephyrdev/zephyr/soc/infineon/cat1c/Kconfig.soc"
osource "D:/zephyrdev/zephyr/soc/infineon/cat1b/Kconfig.soc"
osource "D:/zephyrdev/zephyr/soc/infineon/cat1a/Kconfig.soc"
osource "D:/zephyrdev/zephyr/soc/gd/gd32/Kconfig.soc"
osource "D:/zephyrdev/zephyr/soc/gaisler/leon3/Kconfig.soc"
osource "D:/zephyrdev/zephyr/soc/gaisler/gr716a/Kconfig.soc"
osource "D:/zephyrdev/zephyr/soc/focaltech/Kconfig.soc"
osource "D:/zephyrdev/zephyr/soc/espressif/Kconfig.soc"
osource "D:/zephyrdev/zephyr/soc/ene/kb1200/Kconfig.soc"
osource "D:/zephyrdev/zephyr/soc/ene/kb106x/Kconfig.soc"
osource "D:/zephyrdev/zephyr/soc/elan/em32f967/Kconfig.soc"
osource "D:/zephyrdev/zephyr/soc/egis/Kconfig.soc"
osource "D:/zephyrdev/zephyr/soc/efinix/sapphire/Kconfig.soc"
osource "D:/zephyrdev/zephyr/soc/cdns/xtensa_sample_controller/Kconfig.soc"
osource "D:/zephyrdev/zephyr/soc/cdns/swerv/Kconfig.soc"
osource "D:/zephyrdev/zephyr/soc/cdns/sample_controller32/Kconfig.soc"
osource "D:/zephyrdev/zephyr/soc/cdns/dc233c/Kconfig.soc"
osource "D:/zephyrdev/zephyr/soc/brcm/bcmvk/Kconfig.soc"
osource "D:/zephyrdev/zephyr/soc/brcm/bcm2712/Kconfig.soc"
osource "D:/zephyrdev/zephyr/soc/brcm/bcm2711/Kconfig.soc"
osource "D:/zephyrdev/zephyr/soc/blackberry/qnxhv_vm/Kconfig.soc"
osource "D:/zephyrdev/zephyr/soc/bflb/Kconfig.soc"
osource "D:/zephyrdev/zephyr/soc/atmel/sam0/Kconfig.soc"
osource "D:/zephyrdev/zephyr/soc/atmel/sam/Kconfig.soc"
osource "D:/zephyrdev/zephyr/soc/aspeed/Kconfig.soc"
osource "D:/zephyrdev/zephyr/soc/arm/Kconfig.soc"
osource "D:/zephyrdev/zephyr/soc/arm/beetle/Kconfig.soc"
osource "D:/zephyrdev/zephyr/soc/antmicro/myra/Kconfig.soc"
osource "D:/zephyrdev/zephyr/soc/andestech/Kconfig.soc"
osource "D:/zephyrdev/zephyr/soc/amd/acp_7_0/Kconfig.soc"
osource "D:/zephyrdev/zephyr/soc/amd/acp_6_0/Kconfig.soc"
osource "D:/zephyrdev/zephyr/soc/ambiq/Kconfig.soc"
osource "D:/zephyrdev/zephyr/soc/allwinner/sun8i_h3/Kconfig.soc"
osource "D:/zephyrdev/zephyr/soc/alif/ensemble/Kconfig.soc"
osource "D:/zephyrdev/zephyr/soc/aesc/Kconfig.soc"
osource "D:/zephyrdev/zephyr/soc/adi/max32/Kconfig.soc"
```
